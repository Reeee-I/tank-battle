/*==============================================================================
 * ========================  【音效测试版】  ==================================
 *
 * 本文件由 无线手柄/HEX_B_IR_Rx/main.c 派生，仅叠加"蜂鸣器音效"，其余代码与原版逐行一致。
 * 角色：红外无线接收端（HEX-B，电脑旁）→ SOUND_ENABLED = 0（不发声）
 *
 * 修改点总览（代码内改动处均带【音效】标注）：
 *   SOUND_ENABLED 置 0：无线接收端在电脑旁，不启用任何音效；
 *   本文件不调用任何 Sound_* 函数，除以下宏定义与头文件包含外与原版一致；
 *   若把 sound_effect.c 一并加入工程，模块将编译为空操作（不包含 Beep.h、
 *   不初始化蜂鸣器），本板行为与未加音效功能时完全一致；
 *   推荐做法：接收端工程不加入 sound_effect.c，保持零告警零占用。
 *   编译：本工程 C51 Define 原为 WIRELESS_RX，无需改动。
 *
 * 使用：把本文件改名 main.c 覆盖到 HEX_B 工程源目录（先备份原文件），并把
 *  *      sound_effect.h（仅头文件）一并拷入工程目录消除 include 提示；本板工程不要
 *  *      加入 sound_effect.c（接收端不发声，保持零告警零占用）。
 *  *      详见 sound 目录下的《音效测试与集成说明.md》。
 *============================================================================*/

/*==============================================================================
 * 双人坦克对战 - 红外无线手柄（HEX-B：红外接收端 + 串口1转发）
 *------------------------------------------------------------------------------
 * 功能：接收 HEX-A（红外发送端/玩家2无线手柄）通过红外（NEC_R05d 协议）
 *       发来的 3 字节数据包，校验格式合法（长度=3、包头=0xAA、玩家号=0x02）
 *       后，通过串口1（板载 USB 口，9600bps 8N1）原样转发给 PC。
 *       PC 端程序无需任何修改即可识别，把本板所在 COM 口自动绑定为"玩家2"。
 *
 *       数据包格式（与现有有线协议完全一致，转发时保持原样）：
 *           字节0 : 0xAA                        包头（固定）
 *           字节1 : 0x02                        玩家号（固定为玩家2）
 *           字节2 : 按键状态位掩码（原样透传，不做任何改动）
 *
 * 接收策略：调用 SetIrRxd() 设置红外接收缓冲区（最大 10 字节），
 *           注册 enumEventIrRxd 红外收包事件回调；
 *           回调中调用 GetIrRxNum() 取实际收到字节数：
 *             长度=3 且包头 AA、玩家号 02 → 转发给 PC（先查串口1发送空闲）；
 *             长度不符 / 格式错误 / 非玩家2包  → 丢弃，不转发。
 *           若长时间未收到红外信号（发送端关机/遮挡/移开），本程序
 *           不发送任何数据，PC 端 0.6s 心跳超时后判定玩家2断开并冻结输入。
 *
 * 硬件连接：本板红外接收管（IR_RXD）接收 HEX-A 发送端红外发射管（IR_TXD）
 *           的信号；本板通过板载 USB 口（串口1 / CH340）连接电脑。
 *
 * 注意：
 *   1) SysClock 必须与实际下载频率一致（STC-B 板为 11.0592MHz 晶振）；
 *   2) 主循环只允许 MySTC_OS()（BSP 铁律），业务全部放入事件回调；
 *   3) 红外模块为单工：本板仅接收转发，不调用 IrPrint()，无需发送；
 *   4) 转发前检查 GetUart1TxStatus()==enumUart1TxFree，避免覆盖发送队列；
 *   5) 串口1(USB)与红外可同时工作互不影响（IR 模块 V3.5a 起已解耦）。
 *
 * 编译环境：Keil uVision4/5 + C51（C89 规范，内存模式 Small）
 * 工程文件：main.c + STC_BSP.lib + inc 头文件目录（本工程自包含副本）
 * 生成文件：..\..\HEX\IR_Relay.hex（统一 HEX 目录，用 STC-ISP 烧录）
 *
 * 数码管身份显示：上电最左位显示 'b'（= 无线接收端 HEX-B），与有线玩家1
 *                （显示 '1'）、有线玩家2（显示 '2'）、无线发送端（显示 'A'）
 *                相区分，一眼即可辨认本板角色。
 *============================================================================*/
#include "STC15F2K60S2.H"   /* 必须：STC15 系列寄存器定义 */
#include "sys.H"            /* 必须：系统初始化/调度/事件回调 */
#include "displayer.h"      /* 显示模块：DisplayerInit / LedPrint */
#include "IR.h"             /* 红外模块：IrInit / SetIrRxd / GetIrRxNum */
#include "uart1.h"          /* 串口1（板载 USB）：Uart1Init / Uart1Print */

/* ---- 【音效】无线接收端（HEX-B）位于电脑旁：禁用音效 ----
 * SOUND_ENABLED 置 0（sound_effect.h 中默认 1，此处先定义以覆盖默认值）。
 * 本文件不调用任何 Sound_* 函数；即使把 sound_effect.c 加入工程，模块也会
 * 编译为空操作，板子没有任何发声行为，与原程序完全一致。 */
#define SOUND_ENABLED   0       /* 0=禁用音效（本板不发声） */
#include "sound_effect.h"

/*--------------------------- 协议常量（勿改动） ------------------------------*/
#define PKT_HEADER      0xAA    /* 数据包包头 */
#define PKT_P2          0x02    /* 玩家2 号（本无线链路固定为玩家2） */

#define IR_RX_MAX       10      /* 红外接收缓冲区最大字节数（每包上限） */

/*--------------------------- 系统变量（必须定义） ---------------------------*/
/* 系统工作时钟频率(Hz)，必须与 STC-ISP 下载时选择的频率一致。
 * STC-B 学习板默认外部晶振 11.0592MHz。 */
code unsigned long SysClock = 11059200;

/* 选用显示模块时必须：数码管显示译码表（displayer 模块会引用该表）。
 * 索引 0~9：数字0~9；10：空；11~15：下/中/上 横杠段；16~25：带小数点的0~9；
 * 追加索引 26：'A'（无线发送端标识）、27：'b'（无线接收端标识），
 * 用于把本板与有线玩家1("1")、玩家2("2") 区分开。 */
#ifdef _displayer_H_
code char decode_table[] = {0x3f,0x06,0x5b,0x4f,0x66,0x6d,0x7d,0x07,0x7f,0x6f,
                            0x00,0x08,0x40,0x01,0x41,0x48,
                            0x3f|0x80,0x06|0x80,0x5b|0x80,0x4f|0x80,0x66|0x80,
                            0x6d|0x80,0x7d|0x80,0x07|0x80,0x7f|0x80,0x6f|0x80,
                            0x77,0x7c};   /* 26:'A' 发送端  27:'b' 接收端 */
#endif

/* 数码管标识索引（对应上面译码表的追加段） */
#define SEG_A       26      /* 'A'：无线发送端（HEX-A，本工程不使用） */
#define SEG_b       27      /* 'b'：无线接收端（HEX-B） */

/*--------------------------------- 用户全局变量 ----------------------------*/
static unsigned char irRxBuf[IR_RX_MAX];  /* 红外接收缓冲区（SetIrRxd 指定） */

/*--------------------------- 红外收包事件回调 -------------------------------*/
/* 每收到一个红外数据包（至少 1 字节）由系统调用一次。
 * 逻辑：取实际字节数 → 校验"长度=3 且 包头 AA 且 玩家号 02" →
 *      通过串口1原样转发给 PC；不合法的包一律丢弃。
 * 转发前检查串口1发送状态：只有空闲（enumUart1TxFree）才发起 Uart1Print，
 * 避免与上一包发送队列冲突（上一包转完前不接收下一个红外包，天然不拥塞）。 */
void myIrRxd_callback(void)
{
    unsigned char rxNum;    /* 本次红外数据包实际字节数 */

    /* ① 获取本次红外数据包大小（仅收包事件后调用有效） */
    rxNum = GetIrRxNum();

    /* ② 格式校验：3 字节数据包 + 包头 0xAA + 玩家号 0x02
     *   （红外模块无包头匹配功能，须由用户代码自行校验） */
    if ((rxNum == 3) && (irRxBuf[0] == PKT_HEADER) && (irRxBuf[1] == PKT_P2))
    {
        /* ③ 转发前检查串口1发送是否空闲 */
        if (GetUart1TxStatus() == enumUart1TxFree)
        {
            /* ④ 原样转发 3 字节（AA, 02, 按键状态），保持数据包不变。
             *    Uart1Print 非阻塞：只要未返回"发送失败"即视为请求已被
             *    系统接受（与原有线手柄代码的判读方式一致）。 */
            if (Uart1Print(irRxBuf, 3) != enumUart1TxFailure)
            {
                /* 转发成功：L0 闪一下作指示（调试用，可删） */
                LedPrint(0x01);
            }
        }
    }
    /* 长度不符 / 包头或玩家号不符 / 非玩家2包：丢弃，不做任何转发 */
}

/*----------------------------------- 主函数 ---------------------------------*/
void main(void)
{
    DisplayerInit();                /* 1. 显示模块加载（提供显示刷新定时基准） */
    SetDisplayerArea(0, 7);         /*    启用 8 个扫描位（LED/数码管正常刷新） */
    LedPrint(0x00);                 /*    初始：LED 全灭 */

    /* 2. 数码管显示本板身份：最左位显示 'b'（= 无线接收端 HEX-B）。
     *    与有线玩家1("1")、有线玩家2("2")、无线发送端("A") 均不同，
     *    一眼即可区分当前板子用途。其余位熄灭（10 = 译码表"空"）。 */
    Seg7Print(SEG_b, 10, 10, 10, 10, 10, 10, 10);

    IrInit(NEC_R05d);               /* 3. 红外模块加载：NEC_R05d 协议 */

    Uart1Init(9600UL);              /* 4. 串口1：板载 USB 口，9600bps 8N1 */

    SetIrRxd(irRxBuf, IR_RX_MAX);   /* 5. 设置红外接收缓冲区与每包最大字节数 */

    SetEventCallBack(enumEventIrRxd, myIrRxd_callback); /* 6. 注册收包回调 */

    MySTC_Init();                   /* 7. 系统初始化（必须，只执行一次） */

    while (1)                       /* 7. 主循环：铁律——只允许 MySTC_OS() */
    {
        MySTC_OS();
    }
}
